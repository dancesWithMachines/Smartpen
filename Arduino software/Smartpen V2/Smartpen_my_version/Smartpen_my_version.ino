//Bibilioteki 
//#include <SPI.h>
#include <Wire.h>
#include <Adafruit_GFX.h>
#include <Adafruit_SSD1306.h>
#include <MLX90393.h>
#include <SimpleKalmanFilter.h>

// Ustwienia dla ekranu
#define OLED_RESET 4
Adafruit_SSD1306 display(128, 32, &Wire, OLED_RESET);

MLX90393 mlx;
MLX90393::txyz data; //Create a structure, called data, of four floats (t, x, y, and z)

SimpleKalmanFilter kfX = SimpleKalmanFilter(10, 10, 0.05); // Measurement Uncertainty, Estimation Uncertainty, Process Variance
SimpleKalmanFilter kfY = SimpleKalmanFilter(10, 10, 0.05);

bool isScreenOn = false;

const int pressureButton = 9;

//Thinkz logo bitmap
const unsigned char thinkzLogo [] PROGMEM = {
  0xff, 0xff, 0xff, 0xff, 0xff, 0xff, 0xff, 0xdf, 0xff, 0xff, 0xff, 0xff, 0xff, 0xff, 0xff, 0xff, 
  0xff, 0xff, 0xff, 0xff, 0xff, 0xff, 0xff, 0x8f, 0xff, 0xff, 0xff, 0xff, 0xff, 0xff, 0xff, 0xff, 
  0xff, 0xff, 0xff, 0xff, 0xff, 0xff, 0xfe, 0x0f, 0xff, 0xff, 0xff, 0xff, 0xff, 0xff, 0xff, 0xff, 
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  0xff, 0xff, 0xff, 0xff, 0xff, 0xff, 0xff, 0xff, 0xff, 0xff, 0xff, 0xff, 0xff, 0xff, 0xff, 0xff
};

void setup() {
  Serial.begin(115200);
  Wire.begin();
  
  pinMode(pressureButton, INPUT);
  
  setUpScreen();
  setScreenToLogo();
  setMagnetmtrConf();  
}

void loop() {
  mlx.readData(data);
  
  output((int)kfX.updateEstimate(data.x)-49,(int)kfY.updateEstimate(data.y)-223,true);
}

//Sets up the screen / Konfiguracja początkowa ekranu
void setUpScreen () {
  if(!display.begin(SSD1306_SWITCHCAPVCC, 0x3C)) { // Address 0x3C for 128x32
    Serial.println(F("!Error connecting with screen"));  
  } else {
    isScreenOn=true;
    display.clearDisplay();
  }
}

//Sets screen to Thinkz Logo / Ustawia ekran na logo thinkz
void setScreenToLogo (){
  if (isScreenOn)
    display.clearDisplay();
    display.drawBitmap(
      (display.width()  - 128 ) / 2,
      (display.height() - 32) / 2,
      thinkzLogo, 128, 32, 1);
    display.display();
}

//This is the serial output of arudino // To jest output dla arduino (serial)
void output(int XValue, int ZValue, bool isWriting) {
  Serial.print("X:");
  Serial.print(XValue);
  Serial.print("/Z:");
  Serial.print(ZValue);
  if (isWriting)
    Serial.println("/I:i//");
  else
    Serial.println("/I:n//");       
}

//Checks if button is pressed (device is writing) / Sprawdza czy guzik jest wciśnnięty (czy użądzenie pisze)
bool readButtonState (){
  if (digitalRead(pressureButton))  //== HIGH (jeżeli nie zadziała)
    return true;
  else
    return false;
}

//Setup Magnetometer / Skonfiguruj magnetometr
void setMagnetmtrConf () {
  mlx.setGainSel(7);
  mlx.setResolution(3, 3, 3); //x, y, z 
  mlx.setOverSampling(0);
  mlx.setDigitalFiltering(0);
  //See MLX90393.h and .cpp for additional functions including:
  //set/getOverSample, set/getTemperatureOverSample, set/getDigitalFiltering, set/getResolution
  //set/getTemperatureCompensation, setOffsets, setWThresholds
  //Resoultion table is located in repository
}

//Get Current Magnetomerer configuration / Sprawdź konfigurację Magnetometru
String getMagnetmtrConf (){
  byte status = mlx.begin();
  String conf= "!Current status: 0x";
  if(status < 0x10)
    conf+="0";
  conf+=(String)status;
  return conf;
}
