//Bibilioteki 
//#include <SPI.h>
#include <Wire.h>
#include <Adafruit_GFX.h>
#include <Adafruit_SSD1306.h>
#include <Mouse.h>

// Ustwienia dla ekranu
#define OLED_RESET 4
Adafruit_SSD1306 display(128, 32, &Wire, OLED_RESET);


bool isScreenOn = false;
bool onStart = true;

int multiplier = 0;
int lastMultiplier;

unsigned long delayTime = 0;
bool wasChanged = false;

char input = "a";
bool hasMistake = false;

int boarder = 860;

int y1 = A6;
int x2 = A7;
int y2 = A8;
int x1 = A9;

int x = 0;
int y = 0;
int lastX=x;
int lastY=y;

//Zmienne testowe

bool firstTouch=false;

int wChuj=100000;

//Thinkz logo bitmap
const unsigned char thinkzLogo [] PROGMEM = {
  0xff, 0xff, 0xff, 0xff, 0xff, 0xff, 0xff, 0xdf, 0xff, 0xff, 0xff, 0xff, 0xff, 0xff, 0xff, 0xff, 
  0xff, 0xff, 0xff, 0xff, 0xff, 0xff, 0xff, 0x8f, 0xff, 0xff, 0xff, 0xff, 0xff, 0xff, 0xff, 0xff, 
  0xff, 0xff, 0xff, 0xff, 0xff, 0xff, 0xfe, 0x0f, 0xff, 0xff, 0xff, 0xff, 0xff, 0xff, 0xff, 0xff, 
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  0xff, 0xff, 0xff, 0xff, 0xff, 0xff, 0xff, 0xff, 0xff, 0xff, 0xff, 0xff, 0xff, 0xff, 0xff, 0xff
};

void setup() {
  Serial.begin(9600);
  Wire.begin();
  Mouse.begin();

  pinMode(A2, OUTPUT); //Buzzer
  
  setUpScreen();
  helloMessage(); 
  setScreenToLogo();
}

void loop() {
  multiplier = analogRead(A3)/100;  //Read multiplier value
  
  x = (readX())*multiplier;
  y = (readY())*multiplier;
  if (x<boarder*multiplier && y <boarder*multiplier){
    output(x, y, true);
    if (!firstTouch)
      mouse(-1*(lastX-x),-1*(lastY-y),true);
    firstTouch=false;
    lastX=x;
    lastY=y;
  }
  else{
    output(lastX, lastY, false);
    mouse(0,0,false);
    firstTouch=true;
  }
    
  if(onStart){
    lastMultiplier = multiplier;
  }
  if (!hasMistake)
    showSensivity();
  checkInput();

  onStart = false;
}

//Sets up the screen / Konfiguracja początkowa ekranu
void setUpScreen () {
  if(!display.begin(SSD1306_SWITCHCAPVCC, 0x3C)) { // Address 0x3C for 128x32
    Serial.println(F("!Error connecting with screen"));  
  } else {
    isScreenOn=true;
    display.clearDisplay();
  }
}

//Sets screen to Thinkz Logo / Ustawia ekran na logo thinkz
void setScreenToLogo (){
  if (isScreenOn)
    display.clearDisplay();
    display.drawBitmap(
      (display.width()  - 128 ) / 2,
      (display.height() - 32) / 2,
      thinkzLogo, 128, 32, 1);
    display.display();
}

void helloMessage (){
  display.setTextSize(3);             // Normal 1:1 pixel scale
  display.setTextColor(SSD1306_WHITE);        // Draw white text
  display.setCursor(15,10);             // Start at top-left corner
  display.println(F("Hello!"));
  display.display();
  delay(2000);
  display.clearDisplay();
  display.setTextSize(2);
  display.setCursor(5,10); 
  display.println(F("welcome to"));
  display.display();
  delay(2000);
}

void allsFineZDedykacjaDlaHuberta (){
  display.clearDisplay();
  display.setTextSize(1); 
  display.setCursor(50,0);
  display.println(F("All's")); 
  display.setTextSize(2);
  display.setCursor(40,10);
  display.println(F("Fine!")); 
  display.display();
  delay(wChuj);
}

void showSensivity(){
  if (multiplier!=lastMultiplier){
    lastMultiplier=multiplier;
    display.clearDisplay();
    display.setTextSize(2); 
    display.setCursor(0,0);
    display.print(F("Sensivity set to:")); 
    display.println(multiplier);
    display.display();
    wasChanged=true;
    delayTime=millis()+2000;    
  }
  if (wasChanged) {    
    if (millis()>delayTime){
      setScreenToLogo();
      wasChanged = false;
    }
  }
}

void checkInput (){
  if(Serial.available())
    input = Serial.read();
  //Serial.println(input);
  switch (input) {
  case 'e':
    display.clearDisplay();
    display.setTextSize(1); 
    display.setCursor(26,0);
    display.println(F("You've got a")); 
    display.setTextSize(2);
    display.setCursor(20,10);
    display.println(F("Mistake!")); 
    display.display();
    digitalWrite(A2, HIGH);
    hasMistake=true;
    break;
  case 'd':
    setScreenToLogo();
    digitalWrite(A2, LOW);
    hasMistake=false;
    break;
  default:
    break;
}
        
}

//This is the Serial output of arudino // To jest output dla arduino (Serial)
void output(int XValue, int ZValue, bool isWriting) {
  Serial.print("X:");
  Serial.print(XValue);
  Serial.print("/Z:");
  Serial.print(ZValue);
  if (isWriting)
    Serial.println("/I:i//");
  else
    Serial.println("/I:n//");       
}

int readX(){
  pinMode(y1, INPUT);
  pinMode(x2, OUTPUT);
  pinMode(y2, INPUT);
  pinMode(x1, OUTPUT);
  
  digitalWrite(x2, LOW);
  digitalWrite(x1, HIGH);
  
  delay(5); //pause to allow lines to power up
  
  return analogRead(y1);
}

int readY(){
  pinMode(y1, OUTPUT);
  pinMode(x2, INPUT);
  pinMode(y2, OUTPUT);
  pinMode(x1, INPUT);
  
  digitalWrite(y1, LOW);
  digitalWrite(y2, HIGH);
  
  delay(5); //pause to allow lines to power up
  
  return analogRead(x2);
}

void mouse(int xm, int ym, bool isPressed){
  Mouse.move(xm, ym, 0);
  if (isPressed)
    Mouse.press();
  else
    Mouse.release();
}
